#include "Keypad.h"  //библиотека клавиатуры
#define RELAY 3 // реле на замок
#define NUM_KEYS 4 // количество знаков в коде

char key; // нажатая клавиша
char myarraw[10][NUM_KEYS] = {{'9','5','2','9'},{'5','9','1','2'},{'0','6','3','4'}, {'5','2','1','4'}, {'1','0','2','5'}, {'8','6','4','3'}, {'2','3','6','0'}, {'1','7','5','4'}, {'7','5','4','7'}, {'9','0','2','5'}}; // массив с верными кодами
char button_pressed[NUM_KEYS]; //массив для хранения нажатых кнопок
int k=0; // счетчик нажатий
int s=0; // счетчик совпадений нажатых кнопок с верными
char keys[4][3] = {
  {'1', '2', '3'},
  {'4', '5', '6'},
  {'7', '8', '9'},
  {'*', '0', '#'}
}; // массив клавиш
byte rowPins[] = {12, 11, 10, 9};     // Подключены строки (4 пина)
byte colPins[] = {8, 7, 6};          // подключены столбцы (4 пина)
Keypad keypad = Keypad( makeKeymap(keys), rowPins, colPins, 4, 3 ); //иниициализировать клавиатуру
 
void setup() {
  pinMode(RELAY, OUTPUT); // реле управления замком
  digitalWrite(RELAY, HIGH); // вход реле инверсный, поэтому его сразу включаем (?!)
}
 
void loop (){ 
  key = keypad.getKey(); // спрашиваем у клавиатуры, есть нажатая кнопка?
  if ( key != NO_KEY ){ // если она все-таки есть
    button_pressed [k] = key; //сохраняем эту кнопочку в массиве
    k = k + 1; // запоминаем сколько уже кнопок нажали
    if(k == NUM_KEYS) { // если нажали нужное количество кнопок
      for (uint8_t count = 0; count < 10; count++) {
        for (uint8_t i = 0; i < NUM_KEYS; i++) { // пройдемся по всему массиву   
          if (button_pressed[i] == myarraw[count][i]) { // и проверим нажатые кнопки с верным кодом    
            s = s + 1; // плюсуем счетчик совпадений
          }
        }
        if(s == NUM_KEYS) //если у нас все кнопки совпали с кодом, то включаем реле
        {
          digitalWrite (RELAY, LOW); // включили реле
          delay (5000); // ждем 5 секунд пока включено реле
          digitalWrite (RELAY, HIGH); // гасим реле
          k=0; //сбрасываем счетчик нажатий нашей переменной
          s=0; // сбрасываем счетчик совпадений нашей переменной
          break; 
        }
        else { // если не все кнопки совпали с верным кодом
          k=0; // обнуляем счетчики, чтобы начать все заново
          s=0; //
        }
      }      
    }
  }
}
